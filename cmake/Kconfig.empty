## components/note4_reader/Kconfig.projbuild
```kconfig
config NOTE4_ENABLE_READER
    bool "TXT and EPUB reader"
    default y
    help
        Enable streamed text/EPUB pagination, the CJK font and reading scenes.
        Local bookmarks work without connectivity. Companion sync is used when
        available. Disabling the reader keeps the calendar and sleep covers.

config NOTE4_ENABLE_BOOK_STORAGE
    bool
    default y if NOTE4_ENABLE_READER || NOTE4_ENABLE_BOOK_TRANSFER || NOTE4_ENABLE_USB_HOST || NOTE4_ENABLE_RUNTIME
```

## components/note4_runtime/Kconfig.projbuild
```kconfig
config NOTE4_ENABLE_RUNTIME
    bool "Sandboxed Lua micro-apps"
    default y
    help
        Enable a foreground-only Lua 5.4 runtime with bounded memory, instructions
        and copied drawing commands. Independent .lua files share the content
        filesystem through a separate app namespace. USB Manager can install
        scripts when USB host management is enabled.

config NOTE4_ENABLE_WASM
    bool "Bounded WebAssembly execution library"
    depends on NOTE4_ENABLE_RUNTIME
    default n
    help
        Optional single-owner Wasm interpreter with copied imports and quotas.
        Lua packages remain the launcher format; this library does not silently
        reinterpret .lua/.zapp files as Wasm. Enable for native integration.

choice NOTE4_WASM_ENGINE
    prompt "WebAssembly backend"
    depends on NOTE4_ENABLE_WASM
    default NOTE4_WASM_ENGINE_WAMR
config NOTE4_WASM_ENGINE_WAMR
    bool "WAMR classic interpreter"
config NOTE4_WASM_ENGINE_WASM3
    bool "Wasm3 metered interpreter"
endchoice
```

## components/note4_self_test/Kconfig
```kconfig
menu "Note4 hardware showcase"

config NOTE4_QUALIFICATION_RF_TARGET_SSID
    string "Optional Wi-Fi SSID for RF qualification"
    default ""
    help
        Leave empty for a generic scan test. Set an SSID to require three
        consecutive observations at or above the configured RSSI threshold.

config NOTE4_QUALIFICATION_RF_THRESHOLD_DBM
    int "RF qualification threshold (dBm)"
    range -100 -20
    default -70

config NOTE4_QUALIFICATION_NFC_URL
    string "Temporary NFC demonstration URL"
    default "https://github.com/Tinnci/zectrix-note4-platform"

endmenu
```

## components/ui/Kconfig.projbuild
```kconfig
config NOTE4_ENABLE_UI_CHINESE
    bool "Simplified Chinese system language"
    default y
    help
        Include Chinese system strings and 16px UI glyphs. The UI reuses the
        reader font when present, or a compact subset without the reader.
        Disable this and the reader to remove all Chinese font data.

config NOTE4_UI_DEFAULT_CHINESE
    bool "Use Chinese until a language preference is saved"
    depends on NOTE4_ENABLE_UI_CHINESE
    default y
```

## components/zectrix_cli/Kconfig.projbuild
```kconfig
config ZECTRIX_ENABLE_USB_CLI
    bool "USB maintenance CLI"
    default y
    help
        Enable the USB serial/JTAG maintenance task and diagnostic executor.
        Disabling the CLI preserves the normal ESP-IDF console and boot logs.

config ZECTRIX_ENABLE_USB_HOST
    bool "USB book and settings management"
    depends on ZECTRIX_ENABLE_USB_CLI
    default y
    help
        Add the USB Manager application and bounded host file-transfer session.
        Books use the existing storage lease without Wi-Fi or the reader.
```

## components/zectrix_connectivity/Kconfig.projbuild
```kconfig
menuconfig ZECTRIX_ENABLE_CONNECTIVITY
    bool "Companion connectivity"
    default y
    help
        Enable BLE pairing, durable companion sync and phone resource requests.
        Uses the NimBLE peripheral configuration in sdkconfig.defaults.
        Disable to remove the connectivity, companion and NFC enrollment services.

config ZECTRIX_ENABLE_WIFI
    bool "Direct Wi-Fi"
    depends on ZECTRIX_ENABLE_CONNECTIVITY
    default y
    help
        Enable the shared AP/STA radio driver and RF scan diagnostics.
        BLE companion sync remains available when this option is disabled.

config ZECTRIX_ENABLE_WIFI_HTTP
    bool "Direct HTTPS resource client"
    depends on ZECTRIX_ENABLE_WIFI
    default y
    help
        Fetch resources directly over Wi-Fi with certificate and date validation.
        Disabling this option removes the HTTPS client and its TLS transport.
        Phone resource requests and local Web book transfer remain independent.

config ZECTRIX_ENABLE_BOOK_TRANSFER
    bool "Web book transfer"
    depends on ZECTRIX_ENABLE_WIFI
    default y
    help
        Enable the temporary authenticated AP/STA Web library and SEND BOOKS scene.
        Does not require the reader or the HTTPS resource client.
```

## components/zectrix_reader/Kconfig.projbuild
```kconfig
config ZECTRIX_ENABLE_READER
    bool "TXT and EPUB reader"
    default y
    help
        Enable streamed text/EPUB pagination, the CJK font and reading scenes.
        Local bookmarks work without connectivity. Companion sync is used when
        available. Disabling the reader keeps the calendar and sleep covers.

config ZECTRIX_ENABLE_BOOK_STORAGE
    bool
    default y if ZECTRIX_ENABLE_READER || ZECTRIX_ENABLE_BOOK_TRANSFER || ZECTRIX_ENABLE_USB_HOST
```

## components/zectrix_runtime/Kconfig.projbuild
```kconfig
config ZECTRIX_ENABLE_RUNTIME
    bool "Sandboxed Lua micro-apps"
    default y
    help
        Enable a foreground-only Lua 5.4 pilot with bounded memory, instructions
        and copied drawing commands. Independent .lua files share the content
        filesystem through a separate app namespace. USB Manager can install
        scripts when USB host management is enabled.
```

## components/zectrix_update/Kconfig.projbuild
```kconfig
config ZECTRIX_ENABLE_UPDATE
    bool "Streamed firmware updates"
    default y
    help
        Enable inactive-slot firmware writing, CRC/header validation and commit.
        Boot partition validation, trial-boot watchdog and rollback confirmation
        remain part of the core system in every configuration.
```

## main/Kconfig.projbuild
```kconfig
menu "Note4 modules"
    config NOTE4_ENABLE_UTILITIES
        bool "Native pocket tools"
        default y
        help
            Include the offline focus timer, browsable calendar and tally
            counter. They share the existing time service and foreground UI;
            no network, storage writes or background task is required.

    rsource "../components/ui/Kconfig.projbuild"
    rsource "../components/note4_connectivity/Kconfig.projbuild"
    rsource "../components/note4_reader/Kconfig.projbuild"
    rsource "../components/note4_runtime/Kconfig.projbuild"
    rsource "../components/note4_cli/Kconfig.projbuild"
    rsource "../components/note4_update/Kconfig.projbuild"
endmenu
```
